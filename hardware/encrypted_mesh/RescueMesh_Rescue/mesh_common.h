#ifndef MESH_COMMON_H
#define MESH_COMMON_H

#include <Arduino.h>
#include <SPI.h>
#include <LoRa.h>
#include <esp_system.h>

#include <Ed25519.h>
#include <Curve25519.h>
#include <SHA256.h>
#include <HKDF.h>
#include <ChaChaPoly.h>

// ============================================================
// LORA HARDWARE
// ============================================================

#define LORA_SCK        18
#define LORA_MISO       19
#define LORA_MOSI       23
#define LORA_CS         27
#define LORA_RST        14
#define LORA_DIO0       26
#define LORA_FREQUENCY  433E6

// ============================================================
// SOS BUTTON
// ============================================================

#define SOS_BUTTON_PIN 33

// ============================================================
// NODE IDS
// ============================================================

#define NODE_A_ID       1
#define NODE_B_ID       2
#define RESCUE_ID       3

// ============================================================
// PROTOCOL
// ============================================================

#define PROTOCOL_MAGIC      0x524D
#define PROTOCOL_VERSION    1

#define PACKET_DATA         1
#define PACKET_ACK          2

#define MAX_LOCATION_LEN    31
#define PLAINTEXT_LEN       36
#define NONCE_LEN            12
#define TAG_LEN              16
#define SIGNATURE_LEN        64

// ============================================================
// RSSI ROUTING
// ============================================================
//
// Stronger RSSI = shorter waiting time.
//
// Example:
// -40 dBm -> very short delay
// -100 dBm -> long delay
//
// This allows a stronger normal relay to transmit first.
// ============================================================

#define RELAY_DELAY_MIN_MS  80
#define RELAY_DELAY_MAX_MS 450

// ============================================================
// RETRY
// ============================================================

#define MAX_SEND_RETRIES       3
#define ACK_WAIT_MS            1200

// ============================================================
// PACKET
// ============================================================
//
// current_root:
//     Evolving routing/hash value.
//
// visited_mask:
//     Stateless indication of which nodes have participated.
//
// origin_root:
//     Initial root generated by:
//
//     SHA256(location + timestamp + origin_node_id)
//
//     This NEVER changes.
//
// timestamp_ms:
//     millis() from originating node.
//
// nonce/ciphertext/tag:
//     Encrypted location + timestamp.
//
// signature:
//     Ed25519 signature over immutable origin data.
//
// current_root and visited_mask are intentionally mutable
// routing information and are NOT part of the Ed25519
// signature.
// ============================================================

struct __attribute__((packed)) MeshPacket
{
    uint16_t magic;
    uint8_t  version;
    uint8_t  type;

    uint8_t  origin_id;
    uint8_t  hop_count;

    uint32_t current_root;
    uint8_t  visited_mask;

    uint32_t origin_root;
    uint32_t timestamp_ms;

    uint8_t  nonce[NONCE_LEN];

    uint8_t  ciphertext[PLAINTEXT_LEN];
    uint8_t  tag[TAG_LEN];

    uint8_t  signature[SIGNATURE_LEN];
};

// ============================================================
// ACK PACKET
// ============================================================

struct __attribute__((packed)) AckPacket
{
    uint16_t magic;
    uint8_t  version;
    uint8_t  type;

    uint8_t  responder_id;
    uint8_t  origin_id;

    uint32_t origin_root;
    uint32_t current_root;

    uint8_t signature[SIGNATURE_LEN];
};

// ============================================================
// HEX KEY CONVERSION
// ============================================================

inline uint8_t hexNibble(char c)
{
    if (c >= '0' && c <= '9')
        return c - '0';

    if (c >= 'a' && c <= 'f')
        return c - 'a' + 10;

    if (c >= 'A' && c <= 'F')
        return c - 'A' + 10;

    return 0;
}

inline bool hexToBytes(
    const char *hex,
    uint8_t *output,
    size_t outputLen)
{
    if (strlen(hex) != outputLen * 2)
        return false;

    for (size_t i = 0; i < outputLen; i++)
    {
        output[i] =
            (hexNibble(hex[i * 2]) << 4) |
             hexNibble(hex[i * 2 + 1]);
    }

    return true;
}

// ============================================================
// NODE MASK
// ============================================================

inline uint8_t nodeMask(uint8_t nodeId)
{
    if (nodeId < 1 || nodeId > 8)
        return 0;

    return (uint8_t)(1U << (nodeId - 1));
}

// ============================================================
// SHA256 -> 32-BIT ROOT
// ============================================================

inline uint32_t sha256ToUint32(
    const uint8_t *data,
    size_t len)
{
    SHA256 sha;

    uint8_t digest[32];

    sha.reset();
    sha.update(data, len);
    sha.finalize(digest, sizeof(digest));

    uint32_t result =
        ((uint32_t)digest[0]) |
        ((uint32_t)digest[1] << 8) |
        ((uint32_t)digest[2] << 16) |
        ((uint32_t)digest[3] << 24);

    memset(digest, 0, sizeof(digest));

    return result;
}

// ============================================================
// INITIAL ROOT
// ============================================================
//
// ROOT0 = SHA256(
//     location +
//     timestamp +
//     origin node id
// )
//
// Only the first 32 bits are stored in the packet.
// ============================================================

inline uint32_t createInitialRoot(
    const char *location,
    uint32_t timestamp,
    uint8_t originId)
{
    SHA256 sha;

    uint8_t digest[32];

    sha.reset();

    sha.update(
        (const uint8_t *)location,
        strlen(location)
    );

    sha.update(
        (const uint8_t *)&timestamp,
        sizeof(timestamp)
    );

    sha.update(
        &originId,
        sizeof(originId)
    );

    sha.finalize(
        digest,
        sizeof(digest)
    );

    uint32_t root =
        ((uint32_t)digest[0]) |
        ((uint32_t)digest[1] << 8) |
        ((uint32_t)digest[2] << 16) |
        ((uint32_t)digest[3] << 24);

    memset(digest, 0, sizeof(digest));

    return root;
}

// ============================================================
// NEXT ROOT
// ============================================================
//
// ROOT_next = SHA256(
//     current_root +
//     receiving_node_id
// )
//
// This is your requested evolving-root mechanism.
// ============================================================

inline uint32_t createNextRoot(
    uint32_t currentRoot,
    uint8_t nodeId)
{
    uint8_t input[5];

    input[0] = (uint8_t)(currentRoot);
    input[1] = (uint8_t)(currentRoot >> 8);
    input[2] = (uint8_t)(currentRoot >> 16);
    input[3] = (uint8_t)(currentRoot >> 24);
    input[4] = nodeId;

    return sha256ToUint32(
        input,
        sizeof(input)
    );
}

// ============================================================
// X25519
// ============================================================
//
// Arduino Crypto's Curve25519::eval() expects the scalar
// in Curve25519 form. Clamp a copy of the raw X25519 private
// key before performing the operation.
// ============================================================

inline bool deriveSharedSecret(
    const uint8_t privateKey[32],
    const uint8_t peerPublicKey[32],
    uint8_t sharedSecret[32])
{
    uint8_t scalar[32];

    memcpy(
        scalar,
        privateKey,
        sizeof(scalar)
    );

    scalar[0] &= 0xF8;
    scalar[31] &= 0x7F;
    scalar[31] |= 0x40;

    bool ok = Curve25519::eval(
        sharedSecret,
        scalar,
        peerPublicKey
    );

    memset(scalar, 0, sizeof(scalar));

    return ok;
}

// ============================================================
// HKDF-SHA256
// ============================================================

inline void deriveEncryptionKey(
    const uint8_t sharedSecret[32],
    uint32_t originRoot,
    uint32_t timestamp,
    uint8_t originId,
    uint8_t key[32])
{
    uint8_t info[13];

    memcpy(
        info,
        "RESCUE-MESH",
        11
    );

    info[11] = originId;

    info[12] =
        (uint8_t)(originRoot ^ timestamp);

    HKDF<SHA256> hkdf;

    hkdf.setKey(
        sharedSecret,
        32
    );

    hkdf.extract(
        key,
        32,
        info,
        sizeof(info)
    );

    hkdf.clear();

    memset(info, 0, sizeof(info));
}

// ============================================================
// RANDOM NONCE
// ============================================================

inline void generateNonce(
    uint8_t nonce[NONCE_LEN])
{
    for (int i = 0; i < NONCE_LEN; i += 4)
    {
        uint32_t r = esp_random();

        nonce[i] = r & 0xFF;

        if (i + 1 < NONCE_LEN)
            nonce[i + 1] = (r >> 8) & 0xFF;

        if (i + 2 < NONCE_LEN)
            nonce[i + 2] = (r >> 16) & 0xFF;

        if (i + 3 < NONCE_LEN)
            nonce[i + 3] = (r >> 24) & 0xFF;
    }
}

// ============================================================
// PLAINTEXT FORMAT
// ============================================================
//
// 32 bytes location
//  4 bytes timestamp
//
// Total = 36 bytes
// ============================================================

inline void createPlaintext(
    const char *location,
    uint32_t timestamp,
    uint8_t plaintext[PLAINTEXT_LEN])
{
    memset(
        plaintext,
        0,
        PLAINTEXT_LEN
    );

    strncpy(
        (char *)plaintext,
        location,
        MAX_LOCATION_LEN
    );

    memcpy(
        plaintext + 32,
        &timestamp,
        sizeof(timestamp)
    );
}

inline uint32_t readTimestamp(
    const uint8_t plaintext[PLAINTEXT_LEN])
{
    uint32_t timestamp;

    memcpy(
        &timestamp,
        plaintext + 32,
        sizeof(timestamp)
    );

    return timestamp;
}

// ============================================================
// ED25519 SIGNED DATA
// ============================================================
//
// Mutable routing fields are excluded.
// ============================================================

struct __attribute__((packed)) SignedData
{
    uint16_t magic;
    uint8_t  version;
    uint8_t  type;

    uint8_t  origin_id;

    uint32_t origin_root;
    uint32_t timestamp_ms;

    uint8_t nonce[NONCE_LEN];

    uint8_t ciphertext[PLAINTEXT_LEN];
    uint8_t tag[TAG_LEN];
};

inline void makeSignedData(
    const MeshPacket &packet,
    SignedData &signedData)
{
    memset(
        &signedData,
        0,
        sizeof(signedData)
    );

    signedData.magic =
        packet.magic;

    signedData.version =
        packet.version;

    signedData.type =
        packet.type;

    signedData.origin_id =
        packet.origin_id;

    signedData.origin_root =
        packet.origin_root;

    signedData.timestamp_ms =
        packet.timestamp_ms;

    memcpy(
        signedData.nonce,
        packet.nonce,
        NONCE_LEN
    );

    memcpy(
        signedData.ciphertext,
        packet.ciphertext,
        PLAINTEXT_LEN
    );

    memcpy(
        signedData.tag,
        packet.tag,
        TAG_LEN
    );
}

// ============================================================
// SIGN DATA PACKET
// ============================================================

inline void signDataPacket(
    MeshPacket &packet,
    const uint8_t privateKey[32],
    const uint8_t publicKey[32])
{
    SignedData signedData;

    makeSignedData(
        packet,
        signedData
    );

    Ed25519::sign(
        packet.signature,
        privateKey,
        publicKey,
        &signedData,
        sizeof(signedData)
    );

    memset(
        &signedData,
        0,
        sizeof(signedData)
    );
}

// ============================================================
// VERIFY DATA PACKET
// ============================================================

inline bool verifyDataPacket(
    const MeshPacket &packet,
    const uint8_t publicKey[32])
{
    SignedData signedData;

    makeSignedData(
        packet,
        signedData
    );

    bool valid =
        Ed25519::verify(
            packet.signature,
            publicKey,
            &signedData,
            sizeof(signedData)
        );

    memset(
        &signedData,
        0,
        sizeof(signedData)
    );

    return valid;
}

// ============================================================
// ENCRYPT LOCATION + TIMESTAMP
// ============================================================

inline bool encryptBody(
    const char *location,
    uint32_t timestamp,
    const uint8_t sharedSecret[32],
    uint32_t originRoot,
    uint8_t originId,
    const uint8_t nonce[NONCE_LEN],
    uint8_t ciphertext[PLAINTEXT_LEN],
    uint8_t tag[TAG_LEN])
{
    uint8_t key[32];

    deriveEncryptionKey(
        sharedSecret,
        originRoot,
        timestamp,
        originId,
        key
    );

    uint8_t plaintext[PLAINTEXT_LEN];

    createPlaintext(
        location,
        timestamp,
        plaintext
    );

    ChaChaPoly cipher;

    if (!cipher.setKey(key, sizeof(key)))
    {
        memset(key, 0, sizeof(key));
        memset(plaintext, 0, sizeof(plaintext));
        return false;
    }

    if (!cipher.setIV(nonce, NONCE_LEN))
    {
        cipher.clear();

        memset(key, 0, sizeof(key));
        memset(plaintext, 0, sizeof(plaintext));

        return false;
    }

    // Authenticate immutable origin information.
    cipher.addAuthData(
        &originRoot,
        sizeof(originRoot)
    );

    cipher.addAuthData(
        &timestamp,
        sizeof(timestamp)
    );

    cipher.addAuthData(
        &originId,
        sizeof(originId)
    );

    cipher.encrypt(
        ciphertext,
        plaintext,
        PLAINTEXT_LEN
    );

    cipher.computeTag(
        tag,
        TAG_LEN
    );

    cipher.clear();

    memset(key, 0, sizeof(key));
    memset(plaintext, 0, sizeof(plaintext));

    return true;
}

// ============================================================
// DECRYPT LOCATION + TIMESTAMP
// ============================================================

inline bool decryptBody(
    const MeshPacket &packet,
    const uint8_t sharedSecret[32],
    uint8_t plaintext[PLAINTEXT_LEN])
{
    uint8_t key[32];

    deriveEncryptionKey(
        sharedSecret,
        packet.origin_root,
        packet.timestamp_ms,
        packet.origin_id,
        key
    );

    ChaChaPoly cipher;

    if (!cipher.setKey(key, sizeof(key)))
    {
        memset(key, 0, sizeof(key));
        return false;
    }

    if (!cipher.setIV(packet.nonce, NONCE_LEN))
    {
        cipher.clear();
        memset(key, 0, sizeof(key));
        return false;
    }

    cipher.addAuthData(
        &packet.origin_root,
        sizeof(packet.origin_root)
    );

    cipher.addAuthData(
        &packet.timestamp_ms,
        sizeof(packet.timestamp_ms)
    );

    cipher.addAuthData(
        &packet.origin_id,
        sizeof(packet.origin_id)
    );

    cipher.decrypt(
        plaintext,
        packet.ciphertext,
        PLAINTEXT_LEN
    );

    bool valid =
        cipher.checkTag(
            packet.tag,
            TAG_LEN
        );

    cipher.clear();

    memset(key, 0, sizeof(key));

    return valid;
}

// ============================================================
// RSSI -> RELAY DELAY
// ============================================================

inline uint32_t relayDelayFromRSSI(
    int rssi)
{
    // Strong signal -> small delay.
    // Weak signal -> large delay.

    if (rssi >= -45)
        return RELAY_DELAY_MIN_MS;

    if (rssi <= -110)
        return RELAY_DELAY_MAX_MS;

    long delay =
        map(
            rssi,
            -110,
            -45,
            RELAY_DELAY_MAX_MS,
            RELAY_DELAY_MIN_MS
        );

    return (uint32_t)delay;
}

// ============================================================
// LORA INITIALIZATION
// ============================================================

inline void initLoRa()
{
    SPI.begin(
        LORA_SCK,
        LORA_MISO,
        LORA_MOSI,
        LORA_CS
    );

    LoRa.setPins(
        LORA_CS,
        LORA_RST,
        LORA_DIO0
    );

    if (!LoRa.begin(LORA_FREQUENCY))
    {
        Serial.println(
            "[LoRa] INIT FAILED"
        );

        while (true)
            delay(1000);
    }

    LoRa.setTxPower(17);
    LoRa.setSpreadingFactor(7);
    LoRa.setSignalBandwidth(125E3);
    LoRa.setCodingRate4(5);

    Serial.println(
        "[LoRa] initialized"
    );

    Serial.print(
        "[LoRa] packet size = "
    );

    Serial.println(
        sizeof(MeshPacket)
    );

    LoRa.receive();
}

// ============================================================
// TRANSMIT DATA
// ============================================================

inline void transmitData(
    const MeshPacket &packet)
{
    LoRa.idle();

    LoRa.beginPacket();

    LoRa.write(
        (const uint8_t *)&packet,
        sizeof(packet)
    );

    LoRa.endPacket();

    LoRa.receive();
}

// ============================================================
// RECEIVE DATA
// ============================================================

inline bool receiveData(
    MeshPacket &packet)
{
    int packetSize =
        LoRa.parsePacket();

    if (packetSize != sizeof(MeshPacket))
    {
        if (packetSize > 0)
        {
            while (LoRa.available())
                LoRa.read();

            LoRa.receive();
        }

        return false;
    }

    int received =
        LoRa.readBytes(
            (uint8_t *)&packet,
            sizeof(packet)
        );

    LoRa.receive();

    return received == sizeof(packet);
}

// ============================================================
// TRANSMIT ACK
// ============================================================

inline void transmitAck(
    const AckPacket &ack)
{
    LoRa.idle();

    LoRa.beginPacket();

    LoRa.write(
        (const uint8_t *)&ack,
        sizeof(ack)
    );

    LoRa.endPacket();

    LoRa.receive();
}

// ============================================================
// ACK SIGNED DATA
// ============================================================

inline void signAck(
    AckPacket &ack,
    const uint8_t privateKey[32],
    const uint8_t publicKey[32])
{
    Ed25519::sign(
        ack.signature,
        privateKey,
        publicKey,
        &ack,
        sizeof(ack) - SIGNATURE_LEN
    );
}

// ============================================================
// VERIFY ACK
// ============================================================

inline bool verifyAck(
    const AckPacket &ack,
    const uint8_t publicKey[32])
{
    return Ed25519::verify(
        ack.signature,
        publicKey,
        &ack,
        sizeof(ack) - SIGNATURE_LEN
    );
}

// ============================================================
// CREATE ACK
// ============================================================

inline void createAck(
    AckPacket &ack,
    uint8_t responderId,
    uint8_t originId,
    uint32_t originRoot,
    uint32_t currentRoot,
    const uint8_t privateKey[32],
    const uint8_t publicKey[32])
{
    memset(
        &ack,
        0,
        sizeof(ack)
    );

    ack.magic =
        PROTOCOL_MAGIC;

    ack.version =
        PROTOCOL_VERSION;

    ack.type =
        PACKET_ACK;

    ack.responder_id =
        responderId;

    ack.origin_id =
        originId;

    ack.origin_root =
        originRoot;

    ack.current_root =
        currentRoot;

    signAck(
        ack,
        privateKey,
        publicKey
    );
}

#endif